## buildroot/Config.in
```kconfig
source "$BR2_EXTERNAL_CUSTOM_TREE_PATH/package/am_2303_driver/Config.in"
source "$BR2_EXTERNAL_CUSTOM_TREE_PATH/package/adc7830_soil_humid_driver/Config.in"
source "$BR2_EXTERNAL_CUSTOM_TREE_PATH/package/read_sensors_job/Config.in"
source "$BR2_EXTERNAL_CUSTOM_TREE_PATH/package/read_sensors_web/Config.in"
```

## buildroot/package/adc7830_soil_humid_driver/Config.in
```kconfig
config BR2_PACKAGE_ADC7830_SOIL_HUMID_DRIVER
	bool "ADC7830 soil humidity driver"
	help
	  LKM adding support for ADC7830 soil humidity up to 8 sensors.
```

## buildroot/package/am_2303_driver/Config.in
```kconfig
config BR2_PACKAGE_AM_2303_DRIVER
	bool "AM 2303 driver"
	help
	  LKM adding support for am 2303 temperature and humidity sensor.
```

## buildroot/package/irrigate_job/Config.in
```kconfig
config BR2_PACKAGE_IRRIGATE_JOB
	select BR2_PACKAGE_PYTHON3
	select BR2_PACKAGE_PYTHON3_SQLITE	
	bool "irrigate job"
	help
	  Python script which irrigate plants.
```

## buildroot/package/irrigation_controller_driver/Config.in
```kconfig
config BR2_PACKAGE_IRRIGATION_CONTROLLER_DRIVER
	bool "irrigation controller driver"
	help
	  LKM adding support for GPIO based irrigation controller.
```

## buildroot/package/read_sensors_job/Config.in
```kconfig
config BR2_PACKAGE_READ_SENSORS_JOB
	select BR2_PACKAGE_PYTHON3
	select BR2_PACKAGE_PYTHON3_SQLITE	
	bool "read sensors job"
	help
	  Python script which reading sensors values and put them in DB.
```

## buildroot/package/read_sensors_web/Config.in
```kconfig
config BR2_PACKAGE_READ_SENSORS_WEB
	select BR2_PACKAGE_PYTHON_UVICORN
	select BR2_PACKAGE_PYTHON_FASTAPI
	select BR2_PACKAGE_PYTHON3_SQLITE	
	select BR2_PACKAGE_PYTHON3
	bool "read sensors web"
	help
	  This package installs a FastAPI service that reads sensor data from DB.
```
